

/*
  Project Name:Waves we hear

  Plays a differential sinwave sound

  circuit:
   16-ohm speaker on AD9850 PIN ZOUT1
   AD9850+ARDUINO+SR04

   LCD  Arduino
  PIN1 = GND
  PIN2 = 5V
  RS(CS) = 8;
  RW(SID)= 9;
  EN(CLK) = 13;
  PIN15 PSB = GND;

  created 27 Oct 2016
  by Jun Chen in SXKJG

  This code is hosted on github.

  git@github:Flanio/waveswehear
*/

/*

  DONE:1AD9850+ARDUINO+SR04
     2显示,通过1602+I2C总线模块来进行实时频率数据显示。采用动态显示输出。这里需要用到
      LiquidCrystal_I2C.h和Wire.h两个类库。 LiquidCrystal_I2C类库在1602文件夹中
      Arduino控制AD9850输出特定频率正弦波，频率根据SR04传回的值处理后获得，输出电压0-1V之间

  TODO:1默认状态下，频率输出值应设置为多少？ 理论上应该关闭端口输出，通过控制控制字节实现
  需要查手册，如何使用参考SetFrequency()方法。
     2通过什么样的方法来做用户接口？  怎样开启功能？自动关闭功能时间设定为多少？
     3功率放大器选择？

*/

#include <Wire.h>
#include <TimerOne.h>
#include "LCD12864RSPI.h"
#define AR_SIZE( a ) sizeof( a ) / sizeof( a[0] )
#define NOP do { __asm__ __volatile__ ("nop"); } while (0)

//AD9850 DDS test
//AD9850  for Arduino+DDS9850
#define DDS_CLOCK 125000000

#define  CLOCK  4  //pin connections for DDS
#define  LOAD 5
#define  DATA  6
#define  RESET 7

//constants for button
const int TrigPin = 2;
const int EchoPin = 3;

int f = 1000; //initial FREQ f=10;    默认状态下频率多少？ 关闭输出？

//初始化1602,设置地址为0x3f，16个字符，两行显示
// set the LCD address to 0x27 for a 20 chars and 4 line display
//unsigned char show0[10];
unsigned char show0[] = {0xC9, 0xF9, 0xD2, 0xF4, 0xC6, 0xB5, 0xC2, 0xCA}; //绍兴科技馆
unsigned char Hz[] = {0x48, 0x7A};
//show0 = (unsigned char *)showx;
unsigned char show1[] = "20-20000Hz";  //没用
unsigned char logo0[] = {                                       //笑脸  科技馆logo
  0x00, 0x00, 0x00, 0x00, 0x00, 0x00, 0x00, 0x00,
  0x00, 0x00, 0x00, 0x00, 0x00, 0x00, 0x00, 0x00,
  0x00, 0x00, 0x00, 0x00, 0x00, 0x00, 0x00, 0x00,
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  0x00, 0x00, 0x00, 0x00, 0x00, 0x00, 0x00, 0x00
};
//测试
float distance = 0;
float T;
char  val[6];
unsigned char  n[6] = {0x20, 0x20, 0x20, 0x20, 0x20, 0x20};
int num;

int BtnStart = 10;                 //定义按钮引脚为10
int BtnPlus = 11;                  // 定义按钮引脚为11
int BtnMinus = 12;                  // 定义按钮引脚为12

int stateStart = LOW;
int statePlus = LOW;
int stateMinus = LOW;

bool StartFlag = true;
int TimerCounter = 0;

void setup() {
  //初始化1602
  //###########################################################
  LCDA.Initialise(); // 屏幕初始化
  delay(100);
  //###########################################################
  Serial.begin(9600);
  // 设置端口模式
  // AD9850 DATA 串口数据输出 CLOCK时钟信号 LOAD FQ_UD 数据锁 RESET 重置位
  pinMode (DATA,  OUTPUT);
  pinMode (CLOCK, OUTPUT);
  pinMode (LOAD,  OUTPUT);
  pinMode (RESET, OUTPUT);

  pinMode(BtnPlus, INPUT);
  pinMode(BtnMinus, INPUT);

  //测试数据输出到串口
  Serial.println("start sensor:");
  //初始化AD 9850
  AD9850_init();
  AD9850_reset();
  //初始化频率
  //SetFrequency(f);
  //displayOn();

  //Timer1.initialize(5000000);
 // Timer1.attachInterrupt(changeFlag);
}

void loop() {
  //delay(1);        // delay in between reads for stability
  Serial.print("\nwait for start trigger:\n");
  int timer = 0;
  while (!checkBtnStart());
  delay(100);
  if (checkBtnStart())
  {
    f = 1000;
    Timer1.initialize(5000000);  //确认开始后，开始正式计时30s
    Timer1.attachInterrupt(changeFlag); 
    Serial.print("main in--start timer------------3-2-1\n");
    displayOn();
    while (StartFlag)
    {
      displayUpdate();
      checkBtnPlus();
      checkBtnMinus();
      //displayUpdate();
    }
    Serial.print("Oops-------main out");
    Timer1.stop();
  }
  
  SetFrequency(0);
  displayClear();
  Serial.print("\nstart delay");
  delay(10000);//二次延时，时间到后，方可进行第二次操作 暂定5s
  Serial.print("\nend delay");
  StartFlag = true;  //StartFlag 有效，下一次直接进入按钮识别程序
  //Timer1.restart();

}

/******************************************************************/
/*中断
  /****×*************************************************************/
void changeFlag()
{
  Serial.print("in interrupt\n");
  if (TimerCounter < 5)
    TimerCounter++;
  else if (TimerCounter == 5)
  {
    TimerCounter = 0;
    StartFlag = false;
  }
}

void delay_(int ms)//自制软件延时
{
  for (int i = 0; i < ms; i++)
  {
    for (unsigned long j = 0; j < 1985; j++) NOP;
  }
}

/******************************************************************/
/*按钮判断*/
void checkBtnPlus()
{
  statePlus = digitalRead(BtnPlus);
    Serial.print("statePlus:  ");
  Serial.print(statePlus);
  Serial.print("-----------");
  if (statePlus && !stateMinus)
  {
    //Serial.print(BtnPlus);
    //pbIn =HIGH;
    Serial.print(" Plus In:");
    if (f >= 20000)
    { ;
    }
    else if (f < 20000 && f >= 10000)
    {
      f = f + 1000;
    }
    else if (f < 10000 && f >= 5000)
    {
      f = f + 500;
    }
    else if (f < 5000 && f >= 2000)
    {
      f = f + 200;
    }
    else
    {
      f = f + 100;
    }
    SetFrequency(f);
    delay_(100);  //采样时间间隔  ms
  }
}
void checkBtnMinus()
{
  stateMinus = digitalRead(BtnMinus);
  Serial.print("stateMinus:  ");
  Serial.print(stateMinus);
  Serial.print("\n");
  if (stateMinus && !statePlus)
  {
    //Serial.print(BtnMinus);
    //pbIn =HIGH;
    Serial.print("Minus In:");
    if (f < 200)
    { ;
    }
    else if (f <= 20000 && f > 10000)
    {
      f = f - 1000;
    }
    else if (f <= 10000 && f > 5000)
    {
      f = f - 500;
    }
    else if (f <= 5000 && f > 2000)
    {
      f = f - 200;
    }
    else
    {
      f = f - 100;
    }
    SetFrequency(f);
    delay_(100);  //采样时间间隔  ms
  }
}
bool checkBtnStart()
{
  stateStart = digitalRead(BtnStart);
  if (stateStart)
    return true;
  else
    return false;
}
/******************************************************************/

/******************************************************************/
/*显示部分   displayUpdate()
  /******************************************************************/
void displayUpdate()
{
  num = 0;  //初始化字符长度为0
  if (f <= 21000 && f >= 0)
  {
    //清除12864所有显示内容，主要目的是清楚多余的零
    // LCDA.CLEAR();//清屏
    delay(10);
    //LCDA.DisplayString(0, 2, show0, AR_SIZE(show0)); //第一行第三格开始，显示文字极客工坊
    delay(100);
    itoa(f, val, 10);  //int 转 uchar
    for (int i = 0; i < 6; i++)  //判断字符串长度
    {
      if (val[i] )
        num++;
      else break;
    }
    Serial.print("数据长度:");
    Serial.print(num);
    LCDA.DisplayString(2, 2, n, num + 1); //第三行第二格开始，显示文字geek-workshop
    LCDA.DisplayString(2, 2, (unsigned char *)val, num); //第三行第二格开始，显示文字geek-workshop
    delay(100);
    //LCDA.CLEAR();//清屏
    //delay(200);
    //LCDA.DrawFullScreen(logo0);
    //delay(5000);
    //设置输出频率
    //SetFrequency(f);
  }
}

void displayOn()
{
  LCDA.DisplayString(0, 2, show0, AR_SIZE(show0)); //第一行第三格开始，显示文字绍兴科技馆
  LCDA.DisplayString(2, 5, Hz , AR_SIZE(Hz)); //第二行第六格开始，显示文字单位 HZ
}
void displayClear()
{
  LCDA.CLEAR();
}
/*******************************************************************/



//设置频率
void SetFrequency(unsigned long frequency)
{
  //tuning word:频率控制字
  unsigned long tuning_word = (frequency * pow(2, 32)) / DDS_CLOCK;
  digitalWrite (LOAD, LOW);

  shiftOut(DATA, CLOCK, LSBFIRST, tuning_word);
  shiftOut(DATA, CLOCK, LSBFIRST, tuning_word >> 8);
  shiftOut(DATA, CLOCK, LSBFIRST, tuning_word >> 16);
  shiftOut(DATA, CLOCK, LSBFIRST, tuning_word >> 24);
  shiftOut(DATA, CLOCK, LSBFIRST, 0x0);  //状态字节  可关闭输出
  digitalWrite (LOAD, HIGH);
}

//初始化AD9850
void AD9850_init()
{

  digitalWrite(RESET, LOW);
  digitalWrite(CLOCK, LOW);
  digitalWrite(LOAD, LOW);
  digitalWrite(DATA, LOW);
}

//AD9850 重置
void AD9850_reset()
{
  //reset sequence is:重设条件是
  // CLOCK & LOAD = LOW  时钟信号和数据锁定装入信号同时为低电平
  //  Pulse RESET high for a few uS (use 5 uS here) RESET高电平保持5uS
  //  Pulse CLOCK high for a few uS (use 5 uS here) CLOCK高电平保持5us
  //  Set DATA to ZERO and pulse LOAD for a few uS (use 5 uS here)
  // 数据输出口置零，并且LOAD FQ_UD 输出高电平保持5uS
  // data sheet diagrams show only RESET and CLOCK being used to reset the device, but I see no output unless I also
  // toggle the LOAD line here.

  digitalWrite(CLOCK, LOW);
  digitalWrite(LOAD, LOW);  //LOAD LOW

  digitalWrite(RESET, LOW);
  delay_(5);
  digitalWrite(RESET, HIGH);  //pulse RESET
  delay_(5);
  digitalWrite(RESET, LOW);
  delay_(5);

  digitalWrite(CLOCK, LOW);
  delay_(5);
  digitalWrite(CLOCK, HIGH);  //pulse CLOCK
  delay_(5);
  digitalWrite(CLOCK, LOW);
  delay_(5);
  digitalWrite(DATA, LOW);    //make sure DATA pin is LOW
  //VERY VERY IMPORTANT !!  CORE STEP!!
  digitalWrite(LOAD, LOW);
  delay_(5);
  digitalWrite(LOAD, HIGH);  //pulse LOAD
  delay_(5);
  digitalWrite(LOAD, LOW);
  // Chip is RESET now
}
